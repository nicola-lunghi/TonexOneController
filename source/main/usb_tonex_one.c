/*
 Copyright (C) 2024  Greg Smith

Licensed under the Apache License, Version 2.0 (the "License");
you may not use this file except in compliance with the License.
You may obtain a copy of the License at

        http://www.apache.org/licenses/LICENSE-2.0

Unless required by applicable law or agreed to in writing, software
distributed under the License is distributed on an "AS IS" BASIS,
WITHOUT WARRANTIES OR CONDITIONS OF ANY KIND, either express or implied.
See the License for the specific language governing permissions and
limitations under the License.
 
*/

//Tonex One device
//-----------------------------
//idVendor = 0x1963
//idProduct = 0x00D1

//Index  LANGID  String
//0x00   0x0000  0x0409 
//0x01   0x0409  "IK Multimedia"
//0x02   0x0409  "ToneX One"
//0x04   0x0409  "ToneX One Record"
//0x05   0x0409  "ToneX One Playback"
//0x06   0x0409  "ToneX Control VCOM"
//0x09   0x0409  "ToneX One USB Input"
//0x0A   0x0409  "ToneX One USB Output"
//0x0B   0x0409  "ToneX One Internal Clock"
//0x0C   0x0409  "ToneX One In 1"
//0x0D   0x0409  "ToneX One In 2"
//0x10   0x0409  "ToneX One Out 1"
//0x11   0x0409  "ToneX One Out 2"
//0x12   0x0409  "xxxxxxxxxxxxxxxxxxxx"     // Serial Number

//Composite Device.
//- 5 interfaces total
//- Communications Device Class "Tonex Control VCOM"
//- Audio Device Class "Audio Protocol IP version 2.00"

//----------------------------------------------------
//Endpoint 7 is the Control endpoint, using CDC protocol.

#include <stdlib.h>
#include <stdio.h>
#include <string.h>
#include "freertos/FreeRTOS.h"
#include "freertos/semphr.h"
#include "freertos/ringbuf.h"
#include "esp_log.h"
#include "usb/usb_host.h"
#include "usb_comms.h"
#include "usb/cdc_acm_host.h"
#include "driver/i2c.h"
#include "usb_comms.h"
#include "usb_tonex_one.h"
#include "control.h"

static const char *TAG = "app_TonexOne";
static cdc_acm_dev_hdl_t cdc_dev;
static RingbufHandle_t buf_handle;

// USB commands obtained from Wireshark logs.
// Firmware version 1.1.4.
// Packet starts and ends with 0x7E. 2nd and 3rd last bytes seem 2 byte Crc
// Bytes 2,3,4,5 change often, possibly randomised?
// Other bytes unclear

// Ideally should have been const but compiler throws error, seems too long
// Bank A
//static uint8_t TonexOneSetPreset1ToBankA[] = {0x7e, 0xb9, 0x3, 0x81, 0x6, 0x3, 0x82, 0x94, 0x0, 0x80, 0xb, 0x3, 0xb9,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 0x74, 0x7e};
//static uint8_t TonexOneSetPreset2ToBankA[] = {0x7e, 0xb9, 0x3, 0x81, 0x6, 0x3, 0x82, 0x94, 0x0, 0x80, 0xb, 0x3, 0xb9,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 0xf1, 0x7e};
//static uint8_t TonexOneSetPreset3ToBankA[] = {0x7e, 0xb9, 0x3, 0x81, 0x6, 0x3, 0x82, 0x94, 0x0, 0x80, 0xb, 0x3, 0xb9,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 0x76, 0x7e};
//static uint8_t TonexOneSetPreset4ToBankA[] = {0x7e, 0xb9, 0x3, 0x81, 0x6, 0x3, 0x82, 0x94, 0x0, 0x80, 0xb, 0x3, 0xb9,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 0x72, 0x7e};
//static uint8_t TonexOneSetPreset5ToBankA[] = {0x7e, 0xb9, 0x3, 0x81, 0x6, 0x3, 0x82, 0x94, 0x0, 0x80, 0xb, 0x3, 0xb9,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 0xf0, 0x7e};
//static uint8_t TonexOneSetPreset6ToBankA[] = {0x7e, 0xb9, 0x3, 0x81, 0x6, 0x3, 0x82, 0x94, 0x0, 0x80, 0xb, 0x3, 0xb9,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 0x75, 0x7e};
//static uint8_t TonexOneSetPreset7ToBankA[] = {0x7e, 0xb9, 0x3, 0x81, 0x6, 0x3, 0x82, 0x94, 0x0, 0x80, 0xb, 0x3, 0xb9,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 0xf2, 0x7e};
//static uint8_t TonexOneSetPreset8ToBankA[] = {0x7e, 0xb9, 0x3, 0x81, 0x6, 0x3, 0x82, 0x94, 0x0, 0x80, 0xb, 0x3, 0xb9,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 0x77, 0x7e};
//static uint8_t TonexOneSetPreset9ToBankA[] = {0x7e, 0xb9, 0x3, 0x81, 0x6, 0x3, 0x82, 0x94, 0x0, 0x80, 0xb, 0x3, 0xb9,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 0xff, 0x7e};
//static uint8_t TonexOneSetPreset10ToBankA[] = {0x7e, 0xb9, 0x3, 0x81, 0x6, 0x3, 0x82, 0x94, 0x0, 0x80, 0xb, 0x3, 0xb9,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 0x7a, 0x7e};
//static uint8_t TonexOneSetPreset11ToBankA[] = {0x7e, 0xb9, 0x3, 0x81, 0x6, 0x3, 0x82, 0x94, 0x0, 0x80, 0xb, 0x3, 0xb9,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 0xfd, 0x7e};
//static uint8_t TonexOneSetPreset12ToBankA[] = {0x7e, 0xb9, 0x3, 0x81, 0x6, 0x3, 0x82, 0x94, 0x0, 0x80, 0xb, 0x3, 0xb9,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 0x78, 0x7e};
//static uint8_t TonexOneSetPreset13ToBankA[] = {0x7e, 0xb9, 0x3, 0x81, 0x6, 0x3, 0x82, 0x94, 0x0, 0x80, 0xb, 0x3, 0xb9,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 0xfa, 0x7e};
//static uint8_t TonexOneSetPreset14ToBankA[] = {0x7e, 0xb9, 0x3, 0x81, 0x6, 0x3, 0x82, 0x94, 0x0, 0x80, 0xb, 0x3, 0xb9,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 0x7f, 0x7e};
//static uint8_t TonexOneSetPreset15ToBankA[] = {0x7e, 0xb9, 0x3, 0x81, 0x6, 0x3, 0x82, 0x94, 0x0, 0x80, 0xb, 0x3, 0xb9,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 0xf8, 0x7e};
//static uint8_t TonexOneSetPreset16ToBankA[] = {0x7e, 0xb9, 0x3, 0x81, 0x6, 0x3, 0x82, 0x94, 0x0, 0x80, 0xb, 0x3, 0xb9,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 0x5d, 0x7e};
//static uint8_t TonexOneSetPreset17ToBankA[] = {0x7e, 0xb9, 0x3, 0x81, 0x6, 0x3, 0x82, 0x94, 0x0, 0x80, 0xb, 0x3, 0xb9,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 0xe0, 0x7e};
//static uint8_t TonexOneSetPreset18ToBankA[] = {0x7e, 0xb9, 0x3, 0x81, 0x6, 0x3, 0x82, 0x94, 0x0, 0x80, 0xb, 0x3, 0xb9,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 0x49, 0x7e};
//static uint8_t TonexOneSetPreset19ToBankA[] = {0x7e, 0xb9, 0x3, 0x81, 0x6, 0x3, 0x82, 0x94, 0x0, 0x80, 0xb, 0x3, 0xb9,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 0xce, 0x7e};
//static uint8_t TonexOneSetPreset20ToBankA[] = {0x7e, 0xb9, 0x3, 0x81, 0x6, 0x3, 0x82, 0x94, 0x0, 0x80, 0xb, 0x3, 0xb9,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 0x4b, 0x7e};

// Bank B
//static uint8_t TonexOneSetPreset1ToBankB[] = {0x7e, 0xb9, 0x3, 0x81, 0x6, 0x3, 0x82, 0x93, 0x0, 0x80, 0xb, 0x3, 0xb9,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 0x31, 0x7e};
//static uint8_t TonexOneSetPreset2ToBankB[] = {0x7e, 0xb9, 0x3, 0x81, 0x6, 0x3, 0x82, 0x93, 0x0, 0x80, 0xb, 0x3, 0xb9,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 0x1d, 0x7e};
//static uint8_t TonexOneSetPreset3ToBankB[] = {0x7e, 0xb9, 0x3, 0x81, 0x6, 0x3, 0x82, 0x93, 0x0, 0x80, 0xb, 0x3, 0xb9,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 0x69, 0x7e};
//static uint8_t TonexOneSetPreset4ToBankB[] = {0x7e, 0xb9, 0x3, 0x81, 0x6, 0x3, 0x82, 0x93, 0x0, 0x80, 0xb, 0x3, 0xb9,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 0x45, 0x7e};
//static uint8_t TonexOneSetPreset5ToBankB[] = {0x7e, 0xb9, 0x3, 0x81, 0x6, 0x3, 0x82, 0x93, 0x0, 0x80, 0xb, 0x3, 0xb9,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 0x81, 0x7e};
//static uint8_t TonexOneSetPreset6ToBankB[] = {0x7e, 0xb9, 0x3, 0x81, 0x6, 0x3, 0x82, 0x93, 0x0, 0x80, 0xb, 0x3, 0xb9,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 0xad, 0x7e};
//static uint8_t TonexOneSetPreset7ToBankB[] = {0x7e, 0xb9, 0x3, 0x81, 0x6, 0x3, 0x82, 0x93, 0x0, 0x80, 0xb, 0x3, 0xb9,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 0xd9, 0x7e};
//static uint8_t TonexOneSetPreset8ToBankB[] = {0x7e, 0xb9, 0x3, 0x81, 0x6, 0x3, 0x82, 0x93, 0x0, 0x80, 0xb, 0x3, 0xb9,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 0xf5, 0x7e};
//static uint8_t TonexOneSetPreset9ToBankB[] = {0x7e, 0xb9, 0x3, 0x81, 0x6, 0x3, 0x82, 0x93, 0x0, 0x80, 0xb, 0x3, 0xb9,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 0x58, 0x7e};
//static uint8_t TonexOneSetPreset10ToBankB[] = {0x7e, 0xb9, 0x3, 0x81, 0x6, 0x3, 0x82, 0x93, 0x0, 0x80, 0xb, 0x3, 0xb9,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 0x74, 0x7e};
//static uint8_t TonexOneSetPreset11ToBankB[] = {0x7e, 0xb9, 0x3, 0x81, 0x6, 0x3, 0x82, 0x93, 0x0, 0x80, 0xb, 0x3, 0xb9,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 0x0, 0x7e};
//static uint8_t TonexOneSetPreset12ToBankB[] = {0x7e, 0xb9, 0x3, 0x81, 0x6, 0x3, 0x82, 0x93, 0x0, 0x80, 0xb, 0x3, 0xb9,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 0x2c, 0x7e};
//static uint8_t TonexOneSetPreset13ToBankB[] = {0x7e, 0xb9, 0x3, 0x81, 0x6, 0x3, 0x82, 0x93, 0x0, 0x80, 0xb, 0x3, 0xb9,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 0x74, 0x7e};
//static uint8_t TonexOneSetPreset14ToBankB[] = {0x7e, 0xb9, 0x3, 0x81, 0x6, 0x3, 0x82, 0x93, 0x0, 0x80, 0xb, 0x3, 0xb9,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 0xdd, 0x7e};
//static uint8_t TonexOneSetPreset15ToBankB[] = {0x7e, 0xb9, 0x3, 0x81, 0x6, 0x3, 0x82, 0x93, 0x0, 0x80, 0xb, 0x3, 0xb9,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 0xa9, 0x7e};
//static uint8_t TonexOneSetPreset16ToBankB[] = {0x7e, 0xb9, 0x3, 0x81, 0x6, 0x3, 0x82, 0x93, 0x0, 0x80, 0xb, 0x3, 0xb9,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 0x85, 0x7e};
//static uint8_t TonexOneSetPreset17ToBankB[] = {0x7e, 0xb9, 0x3, 0x81, 0x6, 0x3, 0x82, 0x93, 0x0, 0x80, 0xb, 0x3, 0xb9,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 0xfa, 0x7e};
//static uint8_t TonexOneSetPreset18ToBankB[] = {0x7e, 0xb9, 0x3, 0x81, 0x6, 0x3, 0x82, 0x93, 0x0, 0x80, 0xb, 0x3, 0xb9,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 0xd6, 0x7e};
//static uint8_t TonexOneSetPreset19ToBankB[] = {0x7e, 0xb9, 0x3, 0x81, 0x6, 0x3, 0x82, 0x93, 0x0, 0x80, 0xb, 0x3, 0xb9,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 0xa2, 0x7e};
//static uint8_t TonexOneSetPreset20ToBankB[] = {0x7e, 0xb9, 0x3, 0x81, 0x6, 0x3, 0x82, 0x93, 0x0, 0x80, 0xb, 0x3, 0xb9,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 0x8e, 0x7e};

// stomp mode
static uint8_t TonexOneSetPreset1ToStomp[] = {0x7e, 0xb9, 0x3, 0x81, 0x6, 0x3, 0x82, 0x93, 0x0, 0x80, 0xb, 0x3, 0xb9,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 0x4, 0x7e};
static uint8_t TonexOneSetPreset2ToStomp[] = {0x7e, 0xb9, 0x3, 0x81, 0x6, 0x3, 0x82, 0x93, 0x0, 0x80, 0xb, 0x3, 0xb9,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 0x85, 0x7e};
static uint8_t TonexOneSetPreset3ToStomp[] = {0x7e, 0xb9, 0x3, 0x81, 0x6, 0x3, 0x82, 0x93, 0x0, 0x80, 0xb, 0x3, 0xb9,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 0xf, 0x7e};
static uint8_t TonexOneSetPreset4ToStomp[] = {0x7e, 0xb9, 0x3, 0x81, 0x6, 0x3, 0x82, 0x93, 0x0, 0x80, 0xb, 0x3, 0xb9,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 0x8e, 0x7e};
static uint8_t TonexOneSetPreset5ToStomp[] = {0x7e, 0xb9, 0x3, 0x81, 0x6, 0x3, 0x82, 0x93, 0x0, 0x80, 0xb, 0x3, 0xb9,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 0x12, 0x7e};
static uint8_t TonexOneSetPreset6ToStomp[] = {0x7e, 0xb9, 0x3, 0x81, 0x6, 0x3, 0x82, 0x93, 0x0, 0x80, 0xb, 0x3, 0xb9,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 0x93, 0x7e};
static uint8_t TonexOneSetPreset7ToStomp[] = {0x7e, 0xb9, 0x3, 0x81, 0x6, 0x3, 0x82, 0x93, 0x0, 0x80, 0xb, 0x3, 0xb9,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 0x19, 0x7e};
static uint8_t TonexOneSetPreset8ToStomp[] = {0x7e, 0xb9, 0x3, 0x81, 0x6, 0x3, 0x82, 0x93, 0x0, 0x80, 0xb, 0x3, 0xb9,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 0x98, 0x7e};
static uint8_t TonexOneSetPreset9ToStomp[] = {0x7e, 0xb9, 0x3, 0x81, 0x6, 0x3, 0x82, 0x93, 0x0, 0x80, 0xb, 0x3, 0xb9,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 0x29, 0x7e};
static uint8_t TonexOneSetPreset10ToStomp[] = {0x7e, 0xb9, 0x3, 0x81, 0x6, 0x3, 0x82, 0x93, 0x0, 0x80, 0xb, 0x3, 0xb9,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 0xa8, 0x7e};
static uint8_t TonexOneSetPreset11ToStomp[] = {0x7e, 0xb9, 0x3, 0x81, 0x6, 0x3, 0x82, 0x93, 0x0, 0x80, 0xb, 0x3, 0xb9,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 0x22, 0x7e};
static uint8_t TonexOneSetPreset12ToStomp[] = {0x7e, 0xb9, 0x3, 0x81, 0x6, 0x3, 0x82, 0x93, 0x0, 0x80, 0xb, 0x3, 0xb9,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 0xa3, 0x7e};
static uint8_t TonexOneSetPreset13ToStomp[] = {0x7e, 0xb9, 0x3, 0x81, 0x6, 0x3, 0x82, 0x93, 0x0, 0x80, 0xb, 0x3, 0xb9,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 0xbd, 0x7e};
static uint8_t TonexOneSetPreset14ToStomp[] = {0x7e, 0xb9, 0x3, 0x81, 0x6, 0x3, 0x82, 0x93, 0x0, 0x80, 0xb, 0x3, 0xb9,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 0x3c, 0x7e};
static uint8_t TonexOneSetPreset15ToStomp[] = {0x7e, 0xb9, 0x3, 0x81, 0x6, 0x3, 0x82, 0x93, 0x0, 0x80, 0xb, 0x3, 0xb9,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 0xb6, 0x7e};
static uint8_t TonexOneSetPreset16ToStomp[] = {0x7e, 0xb9, 0x3, 0x81, 0x6, 0x3, 0x82, 0x93, 0x0, 0x80, 0xb, 0x3, 0xb9,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 0x37, 0x7e};
static uint8_t TonexOneSetPreset17ToStomp[] = {0x7e, 0xb9, 0x3, 0x81, 0x6, 0x3, 0x82, 0x93, 0x0, 0x80, 0xb, 0x3, 0xb9,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 0xdd, 0x7e};
static uint8_t TonexOneSetPreset18ToStomp[] = {0x7e, 0xb9, 0x3, 0x81, 0x6, 0x3, 0x82, 0x93, 0x0, 0x80, 0xb, 0x3, 0xb9,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 0x5c, 0x7e};
static uint8_t TonexOneSetPreset19ToStomp[] = {0x7e, 0xb9, 0x3, 0x81, 0x6, 0x3, 0x82, 0x93, 0x0, 0x80, 0xb, 0x3, 0xb9,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 0xd6, 0x7e};
static uint8_t TonexOneSetPreset20ToStomp[] = {0x7e, 0xb9, 0x3, 0x81, 0x6, 0x3, 0x82, 0x93, 0x0, 0x80, 0xb, 0x3, 0xb9,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 0x7b, 0x7e};

#define MAX_PRESETS         20
#define MAX_TX_SIZE         64

// Tonex One seems to have a small and a large preset response.
// When app first connects, it appears to request a summary of all presets. 
// Response starts and ends with 0x7E. Looks like maybe if 0x7E is in the data stream itself, its escaped by adding a second 0x7E??
// Data stream seems to be chunked with marker 0xB9 seemingly involved.
// 0xB9, 0x02, 0xBC, 0x21 seems to be prefix to text chunks
//
// Response from Tonex One to a preset change is about 1202, 1352, 1361 bytes with details of the preset. 
// preset name is proceeded by this byte sequence:
static const uint8_t ToneOnePresetByteMarker[] = {0xB9, 0x04, 0xB9, 0x02, 0xBC, 0x21};

// drive type is proceeded by this byte sequence:
//static const uint8_t ToneOneCharacterByteMarker[] = { 0x0A, 0xB9, 0x02, 0xBC, 0x21};

// lengths of preset name and drive character
#define TONEX_ONE_RESP_OFFSET_PRESET_NAME_LEN       32
//#define TONEX_ONE_RESP_OFFSET_CHARACTER_NAME_LEN    8


// Tonex One can send quite large data quickly, so make a generous receive buffer
#define RX_RING_BUFFER_SIZE     4096
#define RX_TEMP_BUFFER_SIZE     2048

#define TONEX_ONE_CDC_INTERFACE_INDEX       0

static char preset_name[TONEX_ONE_RESP_OFFSET_PRESET_NAME_LEN + 1];

static QueueHandle_t input_queue;

/****************************************************************************
* NAME:        
* DESCRIPTION: 
* PARAMETERS:  
* RETURN:      
* NOTES:       
*****************************************************************************/
static bool usb_tonex_one_handle_rx(const uint8_t* data, size_t data_len, void* arg)
{
    //ESP_LOGI(TAG, "CDC Data received");
    //ESP_LOG_BUFFER_HEXDUMP(TAG, data, data_len, ESP_LOG_INFO);

    // add to ring buffer
    if (xRingbufferSendFromISR(buf_handle, data, data_len, NULL) != pdTRUE) 
    {
        ESP_LOGE(TAG, "Failed to send message to ring buffer!");
        return false;
    }

    return true;
}

/****************************************************************************
* NAME:        
* DESCRIPTION: 
* PARAMETERS:  
* RETURN:      
* NOTES:       
*****************************************************************************/
void usb_tonex_one_handle(class_driver_t* driver_obj)
{
    size_t receivedMessageSize;  
    void* temp_ptr;  
    uint8_t* tx_data;
    uint32_t tx_len;
    tUSBMessage message;
    esp_err_t ret;
    uint32_t send_length;
    uint8_t* send_ptr;

    // check for any input messages
    if (xQueueReceive(input_queue, (void*)&message, 0) == pdPASS)
    {
        ESP_LOGI(TAG, "Got Input message: %d", message.Command);

        // process it
        switch (message.Command)
        {
            case USB_COMMAND_SET_PRESET:
            {
                switch (message.Payload)
                {
                    case 0:
                    {
                        tx_data = TonexOneSetPreset1ToStomp;
                        tx_len = sizeof(TonexOneSetPreset1ToStomp);
                    } break;

                    case 1:
                    {
                        tx_data = TonexOneSetPreset2ToStomp;
                        tx_len = sizeof(TonexOneSetPreset2ToStomp);
                    } break;

                    case 2:
                    {
                        tx_data = TonexOneSetPreset3ToStomp;
                        tx_len = sizeof(TonexOneSetPreset3ToStomp);
                    } break;

                    case 3:
                    {
                        tx_data = TonexOneSetPreset4ToStomp;
                        tx_len = sizeof(TonexOneSetPreset4ToStomp);
                    } break;
                    
                    case 4:
                    {
                        tx_data = TonexOneSetPreset5ToStomp;
                        tx_len = sizeof(TonexOneSetPreset5ToStomp);
                    } break;

                    case 5:
                    {
                        tx_data = TonexOneSetPreset6ToStomp;
                        tx_len = sizeof(TonexOneSetPreset6ToStomp);
                    } break;

                    case 6:
                    {
                        tx_data = TonexOneSetPreset7ToStomp;
                        tx_len = sizeof(TonexOneSetPreset7ToStomp);
                    } break;

                    case 7:
                    {
                        tx_data = TonexOneSetPreset8ToStomp;
                        tx_len = sizeof(TonexOneSetPreset8ToStomp);
                    } break;

                    case 8:
                    {
                        tx_data = TonexOneSetPreset9ToStomp;
                        tx_len = sizeof(TonexOneSetPreset9ToStomp);
                    } break;

                    case 9:
                    {
                        tx_data = TonexOneSetPreset10ToStomp;
                        tx_len = sizeof(TonexOneSetPreset10ToStomp);
                    } break;

                    case 10:
                    {
                        tx_data = TonexOneSetPreset11ToStomp;
                        tx_len = sizeof(TonexOneSetPreset11ToStomp);
                    } break;

                    case 11:
                    {
                        tx_data = TonexOneSetPreset12ToStomp;
                        tx_len = sizeof(TonexOneSetPreset12ToStomp);
                    } break;

                    case 12:
                    {
                        tx_data = TonexOneSetPreset13ToStomp;
                        tx_len = sizeof(TonexOneSetPreset13ToStomp);
                    } break;

                    case 13:
                    {
                        tx_data = TonexOneSetPreset14ToStomp;
                        tx_len = sizeof(TonexOneSetPreset14ToStomp);
                    } break;

                    case 14:
                    {
                        tx_data = TonexOneSetPreset15ToStomp;
                        tx_len = sizeof(TonexOneSetPreset15ToStomp);
                    } break;

                    case 15:
                    {
                        tx_data = TonexOneSetPreset16ToStomp;
                        tx_len = sizeof(TonexOneSetPreset16ToStomp);
                    } break;

                    case 16:
                    {
                        tx_data = TonexOneSetPreset17ToStomp;
                        tx_len = sizeof(TonexOneSetPreset17ToStomp);
                    } break;

                    case 17:
                    {
                        tx_data = TonexOneSetPreset18ToStomp;
                        tx_len = sizeof(TonexOneSetPreset18ToStomp);
                    } break;

                    case 18:
                    {
                        tx_data = TonexOneSetPreset19ToStomp;
                        tx_len = sizeof(TonexOneSetPreset19ToStomp);
                    } break;

                    case 19:
                    default:
                    {
                        tx_data = TonexOneSetPreset20ToStomp;
                        tx_len = sizeof(TonexOneSetPreset20ToStomp);
                    } break;
                }        

                // send it in 64 byte chunks
                send_ptr = tx_data;
                while (tx_len > 0)
                {
                    if (tx_len > MAX_TX_SIZE)
                    {
                        // send a chunk
                        send_length = MAX_TX_SIZE;
                    }
                    else
                    {
                        // send the rest
                        send_length = tx_len;
                    }

                    ret = cdc_acm_host_data_tx_blocking(cdc_dev, send_ptr, send_length, 500);
                   
                    if (ret != ESP_OK)
                    {
                        ESP_LOGE(TAG, "cdc_acm_host_data_tx_blocking() failed: %s", esp_err_to_name(ret));   
                        // return to queue and try again next time??
                        break;
                    }

                    send_ptr += send_length;
                    tx_len -= send_length;
                }

                ESP_LOGI(TAG, "cdc send end");
            } break;           
        }
    }

    // check if we have received anything in ring buffer (via RX interrupt)
    uint8_t* receivedMessage = (uint8_t*)xRingbufferReceiveUpTo(buf_handle, &receivedMessageSize, 0, RX_TEMP_BUFFER_SIZE);

    // Check if the receive operation was successful
    if (receivedMessage != NULL) 
    {
        ESP_LOGI(TAG, "Got data via CDC");

        // check for ToneOnePresetByteMarker[]
        temp_ptr = memmem((void*)receivedMessage, receivedMessageSize, (void*)ToneOnePresetByteMarker, sizeof(ToneOnePresetByteMarker));
        if (temp_ptr != NULL)
        {
            // grab name
            // todo: check if we have a partial packet, and avoid overflowing past the end
            memcpy((void*)preset_name, (void*)(temp_ptr + sizeof(ToneOnePresetByteMarker)), TONEX_ONE_RESP_OFFSET_PRESET_NAME_LEN);
            control_set_preset_name(preset_name);
        }

        // Return the received message to the ring buffer (delete processed bytes)
        vRingbufferReturnItem(buf_handle, (void*)receivedMessage);
    } 
}

/****************************************************************************
* NAME:        
* DESCRIPTION: 
* PARAMETERS:  
* RETURN:      
* NOTES:       
*****************************************************************************/
void usb_tonex_one_init(class_driver_t* driver_obj, QueueHandle_t comms_queue)
{
    // save the queue handle
    input_queue = comms_queue;

    // create ring buffer for data receieve
    buf_handle = xRingbufferCreate(RX_RING_BUFFER_SIZE, RINGBUF_TYPE_BYTEBUF);
    if (buf_handle == NULL) 
    {
        ESP_LOGE(TAG, "Failed to create ring buffer");
    }

    // code from ESP support forums, work around start. Refer to https://www.esp32.com/viewtopic.php?t=30601
    // Relates to this:
    // 
    // Endpoint Descriptor:
    // ------------------------------
    // 0x07	bLength
    // 0x05	bDescriptorType
    // 0x87	bEndpointAddress  (IN endpoint 7)
    // 0x02	bmAttributes      (Transfer: Bulk / Synch: None / Usage: Data)
    // 0x0040	wMaxPacketSize    (64 bytes)
    // 0x00	bInterval         
    // *** ERROR: Invalid wMaxPacketSize. Must be 512 bytes in high speed mode.

    //Endpoint Descriptor:
    //------------------------------
    // 0x07	bLength
    // 0x05	bDescriptorType
    // 0x07	bEndpointAddress  (OUT endpoint 7)
    // 0x02	bmAttributes      (Transfer: Bulk / Synch: None / Usage: Data)
    // 0x0200	wMaxPacketSize    (512 bytes)   <= invalid for full speed mode we are using here
    // 0x00	bInterval         
    const usb_config_desc_t* config_desc;
    ESP_ERROR_CHECK(usb_host_get_active_config_descriptor(driver_obj->dev_hdl, &config_desc));

    // fix wMaxPacketSize
    int off = 0;
    uint16_t wTotalLength = config_desc->wTotalLength;
    const usb_standard_desc_t *next_desc = (const usb_standard_desc_t *)config_desc;
    if (next_desc)
    {
        do
        {
            if (next_desc->bDescriptorType == USB_B_DESCRIPTOR_TYPE_ENDPOINT)
            {
                usb_ep_desc_t *mod_desc = (usb_ep_desc_t *)next_desc;
                if (mod_desc->wMaxPacketSize > 64)
                {
                    ESP_LOGW(TAG, "EP 0x%02X with wrong wMaxPacketSize %d - fixed to 64", mod_desc->bEndpointAddress, mod_desc->wMaxPacketSize);
                    mod_desc->wMaxPacketSize = 64;
                }
            }

            next_desc = usb_parse_next_descriptor(next_desc, wTotalLength, &off);
        } while (next_desc != NULL);
    }
    // code from forums, work around end

    // install CDC host driver
    ESP_ERROR_CHECK(cdc_acm_host_install(NULL));

    ESP_LOGI(TAG, "Opening CDC ACM device 0x%04X:0x%04X", IK_MULTIMEDIA_USB_VENDOR, TONEX_ONE_PRODUCT_ID);

    // set the config
    const cdc_acm_host_device_config_t dev_config = {
        .connection_timeout_ms = 5000,
        .out_buffer_size = 64,
        .user_arg = NULL,
        .event_cb = NULL,
        .data_cb = usb_tonex_one_handle_rx
    };
    
    // open it
    ESP_ERROR_CHECK(cdc_acm_host_open(IK_MULTIMEDIA_USB_VENDOR, TONEX_ONE_PRODUCT_ID, TONEX_ONE_CDC_INTERFACE_INDEX, &dev_config, &cdc_dev));
    assert(cdc_dev);
    
    //cdc_acm_host_desc_print(cdc_dev);
    vTaskDelay(100);

    ESP_LOGI(TAG, "Setting up line coding");

    cdc_acm_line_coding_t line_coding;
    ESP_ERROR_CHECK(cdc_acm_host_line_coding_get(cdc_dev, &line_coding));
    ESP_LOGI(TAG, "Line Get: Rate: %d, Stop bits: %d, Parity: %d, Databits: %d", (int)line_coding.dwDTERate, (int)line_coding.bCharFormat, (int)line_coding.bParityType, (int)line_coding.bDataBits);

    // set line coding
    ESP_LOGI(TAG, "Set line coding");
    cdc_acm_line_coding_t new_line_coding = {
        .dwDTERate = 115200,
        .bCharFormat = 0,
        .bParityType = 0,
        .bDataBits = 8
    };

    if (cdc_acm_host_line_coding_set(cdc_dev, &new_line_coding) != ESP_OK)
    {
        ESP_LOGE(TAG, "Set line coding failed");
    }

    // disable flow control
    ESP_LOGI(TAG, "Set line state");
    if (cdc_acm_host_set_control_line_state(cdc_dev, true, true) != ESP_OK)
    {
        ESP_LOGE(TAG, "Set line state failed");
    }

    // let things finish init and settle
    vTaskDelay(250);

    // update UI
    control_set_max_presets(MAX_PRESETS);
    control_set_usb_status(1);
}

/****************************************************************************
* NAME:        
* DESCRIPTION: 
* PARAMETERS:  
* RETURN:      
* NOTES:       
*****************************************************************************/
void usb_tonex_one_deinit(void)
{
    //cdc_acm_host_close();
}
